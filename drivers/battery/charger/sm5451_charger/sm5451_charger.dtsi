&qupv3_se3_i2c {
	status = "okay";

	sm5451_charger: sm5451@63 {
		compatible = "siliconmitus,sm5451";
		reg = <0x63>;
	};
};

/* /home/dpi/qb5_8814/workspace/P4_1716/android/kernel/kmodule/battery/suwon/charger/sm5451/sm5451_charger.a73xq.dtsi */
&sm5451_charger {
	sm5451,en_vbatreg = <1>;
};
