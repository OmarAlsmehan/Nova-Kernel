## Kconfig
```kconfig
# SPDX-License-Identifier: GPL-2.0
#
# For a description of the syntax of this configuration file,
# see Documentation/kbuild/kconfig-language.rst.
#
mainmenu "Linux/$(ARCH) $(KERNELVERSION) Kernel Configuration"

source "scripts/Kconfig.include"

source "init/Kconfig"

source "kernel/Kconfig.freezer"

source "fs/Kconfig.binfmt"

source "mm/Kconfig"

source "net/Kconfig"

source "drivers/Kconfig"

source "fs/Kconfig"

source "security/Kconfig"

source "crypto/Kconfig"

source "lib/Kconfig"

source "lib/Kconfig.debug"

source "Documentation/Kconfig"

source "techpack/display/msm/dp/Kconfig"

source "techpack/camera/drivers/Kconfig"

source "test/Kconfig"

if !SEC_A73XQ_PROJECT
source "techpack/display/msm/samsung/S6E3FC3_AMS646YD01_LO/Kconfig"
if SEC_M52XQ_PROJECT
source "techpack/display/msm/samsung/SW83109_BF067XMM/Kconfig"
source "techpack/display/msm/samsung/S6E3HAB_AMB667AN01/Kconfig"
source "techpack/display/msm/samsung/S6E3FA9_AMB667UM36/Kconfig"
endif
endif
if SEC_A73XQ_PROJECT
source "techpack/display/msm/samsung/SW83109_WM6676Z21/Kconfig"
source "techpack/display/msm/samsung/SW83109_BF067XMM_A73/Kconfig"
source "techpack/display/msm/samsung/A73_S6E3FC3_AMB667BV01/Kconfig"
source "techpack/display/msm/samsung/S6E3HAB_AMB667AN01_A73/Kconfig"
endif
source "techpack/display/msm/samsung/Kconfig" # ADDED BY LEGO AUTOMATICALLY: DO NOT SUBMIT
```

## arch/arm64/Kconfig.projects
```kconfig
config SEC_A52SXQ_PROJECT
	depends on ARCH_YUPIK
	default n
	bool "Samsung A52SXQ Project"
	help
	  Support for Samsung A52SXQ Project

config MACH_A52SXQ_EUR_OPEN
	depends on SEC_A52SXQ_PROJECT
	default n
	bool "Samsung A52SXQ EUR OPEN"
	help
	  Support for Samsung A52SXQ EUR OPEN device.

config MACH_A52SXQ_KOR_SINGLE
	depends on SEC_A52SXQ_PROJECT
	default n
	bool "Samsung A52SXQ KOR SINGLE"
	help
	  Support for Samsung A52SXQ KOR SINGLE device.

config MACH_A52SXQ_CHN_TW
	depends on SEC_A52SXQ_PROJECT
	default n
	bool "Samsung A52SXQ CHN TW"
	help
	  Support for Samsung A52SXQ CHN TW device.

config SEC_M52XQ_PROJECT
       depends on ARCH_YUPIK
       default n
       bool "Samsung M52XQ Project"
       help
         Support for Samsung M52XQ Project

config MACH_M52XQ_EUR_OPEN
       depends on SEC_M52XQ_PROJECT
       default n
       bool "Samsung M52XQ EUR OPEN"
       help
         Support for Samsung M52XQ EUR OPEN device.

config SEC_A73XQ_PROJECT
	depends on ARCH_YUPIK
	default n
	bool "Samsung A73XQ Project"
	help
	  Support for Samsung A73XQ Project

config MACH_A73XQ_EUR_OPEN
	depends on SEC_A73XQ_PROJECT
	default n
	bool "Samsung A73XQ EUR OPEN"
	help
	  Support for Samsung A73XQ EUR OPEN device.
```
